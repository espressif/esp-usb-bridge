## sdkconfig.defaults.esp32s2
```kconfig
CONFIG_IDF_TARGET="esp32s2"
CONFIG_ESP_DEFAULT_CPU_FREQ_MHZ_240=y
CONFIG_ESP_DEFAULT_CPU_FREQ_MHZ=240
CONFIG_ESP32S2_INSTRUCTION_CACHE_16KB=y
CONFIG_ESP32S2_DATA_CACHE_16KB=y
```

## sdkconfig.defaults.esp32s3
```kconfig
CONFIG_IDF_TARGET="esp32s3"
CONFIG_ESP_DEFAULT_CPU_FREQ_MHZ_240=y
CONFIG_ESP_DEFAULT_CPU_FREQ_MHZ=240
CONFIG_ESP32S3_INSTRUCTION_CACHE_32KB=y
CONFIG_ESP32S3_DATA_CACHE_64KB=y
```

## sdkconfig.defaults.esp_prog2
```kconfig
# This file is used to pass ESP-Prog-2 specific options when building firmware for the probe
# To pass it to the build system, set the SDKCONFIG_DEFAULTS environment environment variable like so:
# export SDKCONFIG_DEFAULTS="sdkconfig.defaults.esp_prog2;skdconfig.defaults.esp32s3"

CONFIG_BRIDGE_PRODUCT_NAME="ESP-Prog-2"
CONFIG_BRIDGE_GPIO_BOOT=33
CONFIG_BRIDGE_GPIO_RST=21
CONFIG_BRIDGE_GPIO_RXD=17
CONFIG_BRIDGE_GPIO_TXD=18
CONFIG_BRIDGE_GPIO_TDI=7
CONFIG_BRIDGE_GPIO_TDO=6
CONFIG_BRIDGE_GPIO_TCK=5
CONFIG_BRIDGE_GPIO_TMS=4
CONFIG_BRIDGE_GPIO_LED1=48
CONFIG_BRIDGE_GPIO_LED2=34
CONFIG_BRIDGE_GPIO_LED3=34
CONFIG_BRIDGE_GPIO_LED1_ACTIVE=0
CONFIG_BRIDGE_GPIO_LED2_ACTIVE=0
CONFIG_BRIDGE_GPIO_LED3_ACTIVE=0
```
